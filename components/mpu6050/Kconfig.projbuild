## components/mpu6050/Kconfig.projbuild
```kconfig
menu "mpu6050 address"
    config AUTO_CONFIG_ADDR
        bool "configure mpu6050 addr at run time"
        default false    
endmenu
```

## main/Kconfig.projbuild
```kconfig
menu "JIRIPOCA CONFIGURATION"
    choice ALTIMETER_VERSION
        prompt "Altimeter Version"
        default ALTIMETER_VERSION_ASR3000_V3
        help
            Select Altimeter version
        config ALTIMETER_VERSION_ASR3000_V3
            bool "ASR3000 V3"
            help
                Choose this for ASR3000 V3, with ESP32-S3. Modules: MPU9250, BMP280, UBlox NEO6M GPS, EBYTE 220 LoRa.
        config ALTIMETER_VERSION_ASR3000_V2
            bool "ASR3000 V2"
            help
                Choose this for ASR3000 V3, with ESP32-S3. Modules: MPU6050, BMP280, UBlox NEO6M GPS, SX127X LoRa.
    endchoice
    menu "Altimeter Configuration"
        config DROGUE_THRESHOLD
            int "Drogue Threshold"
            default 20
            help
                Difference in altitude to trigger drogue chute.
        config MAIN_ALTITUDE
            int "Main Deployment Altitude"
            default 500
            help
                Altitude from ground to trigger main chute.
        config TIMEZONE
            int "Timezone"
            default -3
            help
                Timezone in hours.
    endmenu
    menu "MPU6050 Configuration"
        depends on ALTIMETER_VERSION_ASR3000_V2
        choice MPU6050_I2C_ADDRESS
            prompt "Select MPU6050 address"
            default MPU6050_I2C_ADDRESS_LOW
            help
                Select I2C address
            config MPU6050_I2C_ADDRESS_LOW
                bool "MPU6050_I2C_ADDRESS_LOW"
                help
                    Choose this when ADDR pin is connected to ground
            config MPU6050_I2C_ADDRESS_HIGH
                bool "MPU6050_I2C_ADDRESS_HIGH"
                help
                    Choose this when ADDR pin is connected to VCC
        endchoice
    endmenu
    menu "E220 Configuration"
        depends on ALTIMETER_VERSION_ASR3000_V3
        config E220_BAUD
            int "Baud Rate"
            default 115200
            help
                E220 baud rate.
        config E220_MODE_BUFFER
            bool "Enable Buffered Mode"
            default y
            help
               Enable sending data in buffered mode.
        config E220_BUFFER_SIZE
            depends on E220_MODE_BUFFER
            int "Buffer Size"
            range 1 400
            default 192
            help
                Number of bytes to write at once to LoRa. Maximum is 255.
    endmenu    
    menu "SD Card Configuration"
        depends on ALTIMETER_VERSION_ASR3000_V3 || ALTIMETER_VERSION_ASR3000_V2
        config MAX_SD_FILES
            int "Max SD files"
            default 16
            help
                Max number of files in SD Card.
        config SD_BUFFER_SIZE
            int "SD Buffer Size"
            default 512
            help
                Number of bytes to write at once to SD Card. Must be a multiple of 64.
        config SD_FORMAT_IF_MOUNT_FAILED
            bool "Format SD Card if mount failed"
            default y
            help
                Format SD Card if mount failed.    
    endmenu
    menu "LittleFS Configuration"
        config MAX_LFS_FILES
            int "Max LittleFS files"
            default 8
            help
                Max number of files in LittleFS.
        config LITTLEFS_BUFFER_SIZE
            int "LittleFS Buffer Size"
            default 512
            help
                Number of bytes to write at once to LittleFS. Must be a multiple of 64.
    endmenu
endmenu
```
